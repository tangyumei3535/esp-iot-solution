## examples/factory/c61eco2_factory/sdkconfig.defaults
```kconfig
#
# Serial flasher config
#
CONFIG_ESPTOOLPY_FLASHSIZE_DETECT=y

#
# Partition Table
#
CONFIG_PARTITION_TABLE_OFFSET=0x10B000
CONFIG_PARTITION_TABLE_CUSTOM=y
# end of Partition Table
CONFIG_SPI_FLASH_DANGEROUS_WRITE_ALLOWED=y
CONFIG_ESPTOOLPY_FLASHSIZE_4MB=y
CONFIG_PARTITION_TABLE_CUSTOM_FILENAME="partitions_singleapp_4m.csv"
CONFIG_UF2_OTA_FACTORY_ONLY=y
```
